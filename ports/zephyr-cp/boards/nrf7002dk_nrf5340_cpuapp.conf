## ports/zephyr-cp/boards/nrf7002dk_nrf5340_cpuapp.conf
```kconfig
CONFIG_NETWORKING=y
CONFIG_WIFI=y

CONFIG_MBEDTLS_SSL_PROTO_TLS1_2=y

CONFIG_LOG=n
CONFIG_ASSERT=n
CONFIG_TEST_RANDOM_GENERATOR=y
```
