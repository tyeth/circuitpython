// SPDX-FileCopyrightText: Copyright (c) 2026 Mikey Sklar
//
// SPDX-License-Identifier: MIT

/* "CP" prefix + CRC8 so cold-boot SRAM is not read as a request. */
&boot_mode {
	reg = <0x0 0x4>;
	prefix = [43 50];
	checksum = <1>;
};
